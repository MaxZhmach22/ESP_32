## main/Kconfig.projbuild
```kconfig
# put here your custom config value
menu "Example Configuration"

config LED_GPIO
    int "LED GPIO number"
    range 0 48
    default 2
    help
    LED GPIO.
    
config LED_GPIO_RECIEVE
    int "LED GPIO RECIEVE number"
    range 0 48
    default 5
    help
    LED GPIO on recieving messages.

config ESP_WIFI_SSID
    string "WiFi SSID"
    default "AsusHome"
    help
	SSID (network name) for the example to connect to.

config ESP_WIFI_PASSWORD
    string "WiFi Password"
    default "89117788551"
    help
	WiFi password (WPA or WPA2) for the example to use.

config ESP_MAXIMUM_RETRY
    int "Maximum retry"
    default 5
    help
        Set the Maximum retry to avoid station reconnecting to the AP unlimited when the AP is really inexistent.

config SERVER_IP
    string "SERVER IPV4 Address"
    default "192.168.0.13"
    help
        SERVER IPV4 Address.
 
config SERVER_PORT
    int "Server Port"
    range 0 65535
    default 3333
    help
        The remote port.
 
config CLIENT_PORT
    int "Client Port"
    range 0 65535
    default 4444
    help
        The local port.
         
config MOTOR_PWM_PIN
    int "Motor PWM Pin"
    default 21
    help
        GPIO pin number for the motor PWM signal

config MOTOR_DIR_PIN
    int "Motor Direction Pin"
    default 22
    help
        GPIO pin number for the motor direction signal
        
config MOTOR_RPWM_PIN
    int "Motor RPWM Pin"
    default 12
    help
        GPIO pin number for the motor rotation PMW signal

config MOTOR_RDIR_PIN
    int "Motor Rotation Pin"
    default 13
    help
        GPIO pin number for the motor rotation signal
endmenu
```
